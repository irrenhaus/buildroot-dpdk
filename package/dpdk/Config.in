## package/dpdk/Config.in
```kconfig
config BR2_PACKAGE_DPDK_ARCH_SUPPORTS
  bool
  depends on BR2_TOOLCHAIN_HAS_SYNC_1 && \
             BR2_TOOLCHAIN_HAS_SYNC_2 && \
             BR2_TOOLCHAIN_HAS_SYNC_4 && \
             BR2_TOOLCHAIN_HAS_SYNC_8
  default y if BR2_x86_i686
  default y if BR2_x86_64
  default y if BR2_aarch64 || BR2_aarch64_be

config BR2_GCC_TARGET_CPU
  string
  default "x86-64-4"

comment "dpdk needs BR2_PACKAGE_BUSYBOX_SHOW_OTHERS"
	depends on !BR2_PACKAGE_BUSYBOX_SHOW_OTHERS

comment "dpdk needs a python interpreter"
  depends on !(BR2_PACKAGE_PYTHON || BR2_PACKAGE_PYTHON3)

comment "dpdk needs a glibc toolchain to be built"
  depends on BR2_PACKAGE_DPDK_ARCH_SUPPORTS
  depends on !BR2_TOOLCHAIN_USES_GLIBC

config BR2_PACKAGE_DPDK
  bool "dpdk"
  depends on (BR2_PACKAGE_PYTHON || BR2_PACKAGE_PYTHON3)
  depends on BR2_PACKAGE_BUSYBOX_SHOW_OTHERS
  depends on BR2_PACKAGE_DPDK_ARCH_SUPPORTS
  depends on BR2_TOOLCHAIN_USES_GLIBC
  select BR2_PACKAGE_PCIUTILS
  select BR2_PACKAGE_NET_TOOLS
  select BR2_PACKAGE_LIBGLIB2
  select BR2_PACKAGE_NUMACTL
  select BR2_PACKAGE_PYTHON_PYELFTOOLS
  help
    DPDK is a set of libraries and drivers for fast packet processing.
    http://www.dpdk.org/

if BR2_PACKAGE_DPDK
    choice
    	prompt "DPDK Version"
      default BR2_DPDK_23.03

    	help
    	  Select the version of dpdk you wish to use.

      config BR2_DPDK_23.03
      	bool "dpdk 23.03"

      config BR2_DPDK_23.07RC
      	bool "dpdk 23.07-rc3"

    endchoice

endif
```
